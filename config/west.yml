## config/west.yml
```yaml
manifest:
  remotes:
    - name: claviger-pc
      url-base: https://github.com/claviger-pc
  projects:
    - name: zmk
      remote: claviger-pc
      revision: dynamic-macro
      import: app/west.yml
  self:
    path: config
```
